
	.DEF _key=R5
_bootup:
	.DB  0x5,0x0
	.DB  0x1E,0x0
	.DB  0x1E,0x0
	.DB  0x7,0x0
	.DB  LOW(_3+0x00),HIGH(_3+0x00)
_modify:
	.DB  0x5,0x0
	.DB  0x1E,0x0
	.DB  0x1E,0x0
	.DB  0x8,0x0
	.DB  LOW(_4+0x00),HIGH(_4+0x00)
_lbldbg:
	.DB  0x1,0x0
	.DB  0xA,0x0
	.DB  0x1E,0x0
	.DB  0x8,0x0
	.DB  LOW(_strbuf),HIGH(_strbuf)
	.DEF _nextwin=R4
	.DEF _curr_ch=R6
_5:
	.DB  0x1,0x0
	.DEF _curr_prb=R8
_6:
	.DB  0x1,0x0
	.DEF _ch_to_search=R10
	.DEF _phase=R13
_58:
	.DB  0xFF
_59:
	.DB  0xFF
_wins:
	.DB  0x2,LOW(_pgmain_handler)
	.DB  HIGH(_pgmain_handler),0x3
	.DB  LOW(_pgrconfig_handler),HIGH(_pgrconfig_handler)
	.DB  0x4,LOW(_pgtconfig_handler)
	.DB  HIGH(_pgtconfig_handler),0x7
	.DB  LOW(_pgchset_handler),HIGH(_pgchset_handler)
	.DB  0x8,LOW(_pgprblist_handler)
	.DB  HIGH(_pgprblist_handler),0x9
	.DB  LOW(_pgprbtypelist_handler),HIGH(_pgprbtypelist_handler)
	.DB  0xA,LOW(_pgprbset_handler)
	.DB  HIGH(_pgprbset_handler),0xB
	.DB  LOW(_pgprbconfig_handler),HIGH(_pgprbconfig_handler)
	.DB  0xD,LOW(_pgboottype_handler)
	.DB  HIGH(_pgboottype_handler)
_Ci:
	.DB  0x49,0x5,0x32,0x40,0xD0,0xC0,0xD2,0x3F
	.DB  0x73,0x6F,0xC,0xBE,0x68,0xEA,0xD4,0xBB
	.DB  0x2D,0xA5,0x19,0xBB,0x9A,0xBA,0xA7,0x3B
	.DB  0x4B,0x64,0xF6,0x3A,0xB6,0x0,0x6,0xBB
	.DB  0xE7,0xCF,0xF1,0xB9,0xB7,0xB9,0xEF,0x39
_Ai:
	.DB  0x88,0xA9,0x8,0xC0,0x52,0xBA,0x4B,0x40
	.DB  0x74,0x95,0xE6,0xBF,0x24,0x9F,0x37,0x3F
	.DB  0x76,0xE1,0x0,0x3F,0x63,0x76,0x1E,0xBF
	.DB  0x73,0x69,0x5A,0xBD,0x29,0x78,0x8F,0x3E
	.DB  0xA2,0x72,0xDB,0x3D,0xDA,0x7,0x96,0xBE
	.DB  0x26,0xAD,0x36,0x3D,0xD0,0x11,0xF3,0x3D
	.DB  0xAC,0xF6,0x56,0xBD
_sizeAi:
	.DB  0xD
_sizeCi:
	.DB  0xA
_Di:
	.DB  0x68,0xF7,0xDB,0x43,0x82,0x35,0xEC,0x43
	.DB  0xEC,0xBC,0x16,0x42,0xC5,0x1A,0xEF,0x40
	.DB  0xD9,0xEE,0x3A,0x40,0x8B,0xDE,0xA9,0x3B
	.DB  0xCB,0xBF,0x76,0xBF,0xF6,0x42,0x41,0xBE
	.DB  0xB8,0xCA,0x43,0x3E,0x70,0xCE,0x48,0x3D
_Bi:
	.DB  0x7A,0xB9,0x3B,0x3E,0x3B,0xC2,0x76,0x3E
	.DB  0x9C,0x20,0x56,0x3E,0xB2,0x2,0x43,0x3E
	.DB  0x73,0x12,0x12,0x3E,0xA,0xBB,0x9F,0x3D
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	.DB  0x8A,0xB6,0xAC,0x3A,0x7C,0x33,0xD5,0x3C
_sizeDi:
	.DB  0xA
_sizeBi:
	.DB  0x10
_TLow:
	.DB  0x0,0x0,0x0,0x0,0x56,0xB6,0x1E,0x3D
	.DB  0x6A,0x5D,0x39,0x38,0xDB,0x5A,0xFE,0x33
	.DB  0xFA,0x14,0xAC,0x32,0xFE,0xC4,0x77,0x30
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	.DB  0x9C,0x79,0x81,0xD
_THigh:
	.DB  0x0,0x0,0x0,0x0,0x56,0xB6,0x1E,0x3D
	.DB  0x42,0xA3,0xB,0x38,0xFF,0x62,0x5D,0x34
	.DB  0xAC,0x5F,0x16,0xB1,0x8D,0x75,0x41,0x2D
	.DB  0x27,0xC8,0xA,0xA9,0x49,0xBC,0x51,0x24
	.DB  0xF,0xED,0x1,0x9F
_SLow:
	.DB  0x0,0x0,0x0,0x0,0xC4,0xC,0xB1,0x3B
	.DB  0x5E,0x48,0x53,0x37,0x72,0xB2,0xC7,0xB2
	.DB  0x39,0xA1,0xD,0x2E,0x56,0x47,0x15,0xA9
	.DB  0xE7,0xE1,0xEB,0x23,0x98,0x3F,0x6C,0x9E
	.DB  0xDC,0x4,0x52,0x18
_SMed:
	.DB  0xD1,0x1C,0xAA,0x3F,0x5A,0x39,0x5B,0x3B
	.DB  0x56,0xB7,0xDB,0x36,0xA4,0x93,0xE2,0xB0
	.DB  0x20,0x2B,0x6A,0x28
_SHigh:
	.DB  0xD4,0xA0,0x12,0x43,0x1,0x51,0x84,0xBE
	.DB  0x29,0xA5,0x2B,0x39,0x28,0xEC,0xD,0xB3
	.DB  0x84,0xEA,0x29,0xA8
_RLow:
	.DB  0x0,0x0,0x0,0x0,0x87,0x54,0xAD,0x3B
	.DB  0x98,0x7B,0x69,0x37,0xEC,0x2C,0xCD,0xB2
	.DB  0x2B,0xF9,0x1C,0x2E,0xF,0x39,0x50,0xA9
	.DB  0x5D,0xF1,0x66,0x24,0xBC,0x31,0x30,0x9F
	.DB  0xB6,0x88,0x98,0x19,0x68,0xA9,0x5E,0x93
_RMed:
	.DB  0xAD,0xE6,0x3C,0x40,0xDC,0x30,0x25,0xBB
	.DB  0x37,0xDA,0x85,0x37,0xDB,0x44,0x3,0xB2
	.DB  0x83,0x78,0x10,0x2C,0x3F,0x1C,0xA9,0xA5
_RHigh:
	.DB  0x6C,0x3B,0x18,0x43,0xC3,0xA2,0x89,0xBE
	.DB  0xB3,0x99,0x33,0x39,0xA3,0x8F,0x14,0xB3
	.DB  0x62,0x5E,0x28,0xA8
_NLow:
	.DB  0x0,0x0,0x0,0x0,0x9F,0x4B,0xD6,0x3C
	.DB  0x9,0xD6,0x37,0x37,0xB2,0x85,0xC9,0xB3
	.DB  0x50,0x1F,0x4C,0xAE,0xEB,0x17,0x39,0xAC
	.DB  0x46,0xB,0xCC,0xA8,0x32,0x73,0xAF,0xA4
	.DB  0xB9,0x94,0xDC,0x9F
_NHigh:
	.DB  0x0,0x0,0x0,0x0,0xE2,0x69,0xD4,0x3C
	.DB  0x46,0xC9,0x83,0x37,0xC9,0x3A,0x3C,0x33
	.DB  0xF0,0xDF,0x8A,0xAF,0x8D,0x5,0x35,0x2B
	.DB  0xA8,0x7,0x91,0xA6,0xB9,0x32,0x93,0x21
	.DB  0xA8,0xF2,0x37,0x9C,0xEC,0xC,0x81,0x16
	.DB  0xC5,0x93,0x1B,0x90
_JLow:
	.DB  0x0,0x0,0x0,0x0,0x81,0x5C,0x4E,0x3D
	.DB  0x5D,0xA6,0xFF,0x37,0xAA,0xFF,0xB7,0xB3
	.DB  0xF,0x72,0x11,0x2F,0xCE,0xFF,0x3F,0xAA
	.DB  0xDA,0x83,0x71,0x25,0xFA,0x6,0x14,0xA0
	.DB  0x47,0x2E,0x97,0x19
_JHigh:
	.DB  0x67,0x3A,0x94,0x43,0xC7,0xB1,0xBF,0xBF
	.DB  0xE9,0x51,0x50,0x3B,0xE9,0xB9,0x55,0xB6
	.DB  0xB7,0x10,0xD8,0x30,0xED,0xC6,0xAC,0xAA
_BLow:
	.DB  0x0,0x0,0x0,0x0,0x3F,0x4B,0x70,0x3D
	.DB  0xA,0xE1,0x3C,0x38,0x42,0x52,0xF8,0x32
	.DB  0x72,0xBB,0xB5,0xAF,0x5,0x7,0x37,0x2B
	.DB  0x1,0x55,0x5D,0xA5,0xF0,0x1,0xB9,0xA1
	.DB  0x31,0x5E,0x22,0x1D,0xE8,0xA4,0xDE,0x97
	.DB  0xE5,0xED,0xE3,0x11
_BHigh:
	.DB  0x4C,0x34,0x79,0xC0,0x4C,0xF,0xEA,0x3C
	.DB  0x58,0x4,0xB2,0xB8,0x3F,0x7E,0x29,0x34
	.DB  0x48,0x1B,0x39,0xAF,0x9A,0x2B,0xFA,0x29
	.DB  0x8B,0x4A,0x4D,0xA4,0xAF,0xF5,0x3A,0x1E
	.DB  0x93,0x22,0x91,0x97
_EHigh:
	.DB  0x0,0x0,0x0,0x0,0x3F,0x4B,0x70,0x3D
	.DB  0xA,0xE1,0x3C,0x38,0x42,0x52,0xF8,0x32
	.DB  0x72,0xBB,0xB5,0xAF,0x5,0x7,0x37,0x2B
	.DB  0x1,0x55,0x5D,0xA5,0xF0,0x1,0xB9,0xA1
	.DB  0x31,0x5E,0x22,0x1D,0xE8,0xA4,0xDE,0x97
	.DB  0xE5,0xED,0xE3,0x11
_ELow:
	.DB  0x0,0x0,0x0,0x0,0x3F,0x4B,0x70,0x3D
	.DB  0xAA,0x77,0x3E,0x38,0xDA,0x5F,0x51,0xB5
	.DB  0x27,0x9F,0xDD,0xB2,0x9,0x6C,0x23,0xB0
	.DB  0xE1,0xFB,0x23,0xAD,0x2,0xA8,0xE7,0xA9
	.DB  0xAF,0xA6,0x67,0xA6,0x76,0x41,0xA2,0xA2
	.DB  0x7E,0x8,0x9B,0x9E,0x90,0xD9,0x3F,0x9A
	.DB  0xC6,0x38,0x8A,0x95,0x73,0xBC,0x2F,0x90
_KLow:
	.DB  0x0,0x0,0x0,0x0,0x75,0x96,0x21,0x3D
	.DB  0xA9,0x28,0xC6,0x37,0xF0,0x68,0xB0,0xB4
	.DB  0xC0,0x78,0xAB,0xB1,0x39,0x74,0x94,0xAE
	.DB  0x80,0x98,0x21,0xAB,0xD9,0x4,0x60,0xA7
	.DB  0x54,0xCC,0x40,0xA3,0x4C,0xD9,0xBB,0x9E
	.DB  0xB,0xDD,0x9D,0x99
_KHigh:
	.DB  0xBE,0x2E,0x90,0xBC,0xD7,0x6B,0x1F,0x3D
	.DB  0xA8,0xAE,0x9B,0x37,0x64,0x95,0xD5,0xB3
	.DB  0x26,0xC,0xAF,0x2F,0xBE,0xD4,0x1D,0xAB
	.DB  0x17,0xA0,0x21,0x26,0x58,0x4,0xBD,0xA0
	.DB  0xA6,0xE5,0xEA,0x1A,0x3B,0xC2,0x6F,0x94
_TLowLen:
	.DB  0xF,0x0
_THighLen:
	.DB  0x9,0x0
_SLowLen:
	.DB  0x9,0x0
_SMedLen:
	.DB  0x5,0x0
_SHighLen:
	.DB  0x5,0x0
_RLowLen:
	.DB  0xA,0x0
_RMedLen:
	.DB  0x6,0x0
_RHighLen:
	.DB  0x5,0x0
_NLowLen:
	.DB  0x9,0x0
_NHighLen:
	.DB  0xB,0x0
_JLowLen:
	.DB  0x9,0x0
_JHighLen:
	.DB  0x6,0x0
_BLowLen:
	.DB  0xB,0x0
_BHighLen:
	.DB  0x9,0x0
_ELowLen:
	.DB  0xE,0x0
_EHighLen:
	.DB  0xB,0x0
_KLowLen:
	.DB  0xB,0x0
_KHighLen:
	.DB  0xA,0x0
_386:
	.DB  0xAA,0xAA,0xAA
_387:
	.DB  0x55,0x55,0x55
_395:
	.DB  0xAA,0xAA,0xAA,0x31,0x32,0x45,0x44,0x55
	.DB  0x55,0x55
_412:
	.DB  0x0,0x0,0x7A,0xC4
_pgmain_chs:
	.DB  0x4,0x0
	.DB  0x4,0x0
	.DB  0x3,0x0
	.DB  0x3,0x0
	.DB  LOW(_strbuf),HIGH(_strbuf)
	.DB  0x1,0x0
	.DB  0x2,0x0
	.DB  0x1E,0x0
	.DB  0x3,0x0
	.DB  LOW(_strbuf),HIGH(_strbuf)
	.DB  0x1,0x0
	.DB  0x2,0x0
	.DB  0x28,0x0
	.DB  0x3,0x0
	.DB  LOW(_strbuf),HIGH(_strbuf)
	.DB  0x1,0x0
	.DB  0x2,0x0
	.DB  0x32,0x0
	.DB  0x3,0x0
	.DB  LOW(_strbuf),HIGH(_strbuf)
_pgmain_values:
	.DB  0x4,0x0
	.DB  0x28,0x0
	.DB  0x3,0x0
	.DB  0x7,0x0
	.DB  LOW(_strbuf),HIGH(_strbuf)
	.DB  0x1,0x0
	.DB  0x28,0x0
	.DB  0x1E,0x0
	.DB  0xA,0x0
	.DB  LOW(_strbuf),HIGH(_strbuf)
	.DB  0x1,0x0
	.DB  0x28,0x0
	.DB  0x28,0x0
	.DB  0xA,0x0
	.DB  LOW(_strbuf),HIGH(_strbuf)
	.DB  0x1,0x0
	.DB  0x28,0x0
	.DB  0x32,0x0
	.DB  0xA,0x0
	.DB  LOW(_strbuf),HIGH(_strbuf)
_pgmain_temps:
	.DB  0x4,0x0
	.DB  0x8C,0x0
	.DB  0x3,0x0
	.DB  0x7,0x0
	.DB  LOW(_strbuf),HIGH(_strbuf)
	.DB  0x1,0x0
	.DB  0x8C,0x0
	.DB  0x1E,0x0
	.DB  0xA,0x0
	.DB  LOW(_strbuf),HIGH(_strbuf)
	.DB  0x1,0x0
	.DB  0x8C,0x0
	.DB  0x28,0x0
	.DB  0xA,0x0
	.DB  LOW(_strbuf),HIGH(_strbuf)
	.DB  0x1,0x0
	.DB  0x8C,0x0
	.DB  0x32,0x0
	.DB  0xA,0x0
	.DB  LOW(_strbuf),HIGH(_strbuf)
_pgr_banner:
	.DB  0x5,0x0
	.DB  0x3,0x0
	.DB  0x3,0x0
	.DB  0x7,0x0
	.DB  LOW(_480+0x00),HIGH(_480+0x00)
_pgr_calibrate:
	.DB  0x5,0x0
	.DB  0x1E,0x0
	.DB  0x1E,0x0
	.DB  0x8,0x0
	.DB  LOW(_481+0x00),HIGH(_481+0x00)
_pgr_klbl:
	.DB  0x1,0x0
	.DB  0x58,0x0
	.DB  0x1C,0x0
	.DB  0x3,0x0
	.DB  LOW(_strbuf),HIGH(_strbuf)
_pgr_options:
	.DB  0x5,0x0
	.DB  0xA,0x0
	.DB  0x17,0x0
	.DB  0x6,0x0
	.DB  LOW(_482+0x00),HIGH(_482+0x00)
	.DB  0x5,0x0
	.DB  0x82,0x0
	.DB  0x17,0x0
	.DB  0x7,0x0
	.DB  LOW(_483+0x00),HIGH(_483+0x00)
	.DB  0x5,0x0
	.DB  0xA,0x0
	.DB  0x2D,0x0
	.DB  0x8,0x0
	.DB  LOW(_484+0x00),HIGH(_484+0x00)
	.DB  0x5,0x0
	.DB  0x82,0x0
	.DB  0x2D,0x0
	.DB  0x7,0x0
	.DB  LOW(_485+0x00),HIGH(_485+0x00)
_0x1E6:
	.DB  0x0,0x0
	.DB  0x0,0x0
	.DEF _curr_sel_S45=R12
_488:
	.DB  0x1
_489:
	.DB  0x1
_pgt_banner:
	.DB  0x5,0x0
	.DB  0x3,0x0
	.DB  0x3,0x0
	.DB  0x7,0x0
	.DB  LOW(_508+0x00),HIGH(_508+0x00)
_pgt_options:
	.DB  0x5,0x0
	.DB  0x28,0x0
	.DB  0x19,0x0
	.DB  0x8,0x0
	.DB  LOW(_509+0x00),HIGH(_509+0x00)
	.DB  0x5,0x0
	.DB  0x28,0x0
	.DB  0x2D,0x0
	.DB  0x8,0x0
	.DB  LOW(_510+0x00),HIGH(_510+0x00)
_511:
	.DB  0x1
_512:
	.DB  0x1
_pgch_banner:
	.DB  0x5,0x0
	.DB  0x3,0x0
	.DB  0x3,0x0
	.DB  0x4,0x0
	.DB  LOW(_529+0x00),HIGH(_529+0x00)
_pgch_chvalue:
	.DB  0x1,0x0
	.DB  0x82,0x0
	.DB  0x3,0x0
	.DB  0x2,0x0
	.DB  LOW(_strbuf),HIGH(_strbuf)
_pgch_items:
	.DB  0x1,0x0
	.DB  0xA,0x0
	.DB  0x1E,0x0
	.DB  0xA,0x0
	.DB  LOW(_strbuf),HIGH(_strbuf)
	.DB  0x1,0x0
	.DB  0x82,0x0
	.DB  0x1E,0x0
	.DB  0xA,0x0
	.DB  LOW(_strbuf),HIGH(_strbuf)
	.DB  0x1,0x0
	.DB  0xA,0x0
	.DB  0x28,0x0
	.DB  0xA,0x0
	.DB  LOW(_strbuf),HIGH(_strbuf)
	.DB  0x1,0x0
	.DB  0x82,0x0
	.DB  0x28,0x0
	.DB  0xA,0x0
	.DB  LOW(_strbuf),HIGH(_strbuf)
	.DB  0x1,0x0
	.DB  0xA,0x0
	.DB  0x32,0x0
	.DB  0xA,0x0
	.DB  LOW(_strbuf),HIGH(_strbuf)
	.DB  0x1,0x0
	.DB  0x82,0x0
	.DB  0x32,0x0
	.DB  0xA,0x0
	.DB  LOW(_strbuf),HIGH(_strbuf)
_pgprbset_banner:
	.DB  0x5,0x0
	.DB  0x3,0x0
	.DB  0x3,0x0
	.DB  0x8,0x0
	.DB  LOW(_574+0x00),HIGH(_574+0x00)
_pgprbset_chvalue:
	.DB  0x1,0x0
	.DB  0xB4,0x0
	.DB  0x3,0x0
	.DB  0x2,0x0
	.DB  LOW(_strbuf),HIGH(_strbuf)
_pgprbset_items:
	.DB  0x1,0x0
	.DB  0xA,0x0
	.DB  0x1E,0x0
	.DB  0xA,0x0
	.DB  LOW(_strbuf),HIGH(_strbuf)
	.DB  0x1,0x0
	.DB  0x82,0x0
	.DB  0x1E,0x0
	.DB  0xA,0x0
	.DB  LOW(_strbuf),HIGH(_strbuf)
	.DB  0x1,0x0
	.DB  0xA,0x0
	.DB  0x28,0x0
	.DB  0xA,0x0
	.DB  LOW(_strbuf),HIGH(_strbuf)
	.DB  0x1,0x0
	.DB  0x82,0x0
	.DB  0x28,0x0
	.DB  0xA,0x0
	.DB  LOW(_strbuf),HIGH(_strbuf)
	.DB  0x1,0x0
	.DB  0xA,0x0
	.DB  0x32,0x0
	.DB  0xA,0x0
	.DB  LOW(_strbuf),HIGH(_strbuf)
	.DB  0x1,0x0
	.DB  0x82,0x0
	.DB  0x32,0x0
	.DB  0xA,0x0
	.DB  LOW(_strbuf),HIGH(_strbuf)
_575:
	.DB  0x1,0x0
_576:
	.DB  0x1,0x0
_0x241:
	.DB  0x1
_prblist_banner:
	.DB  0x5,0x0
	.DB  0x3,0x0
	.DB  0x3,0x0
	.DB  0x8,0x0
	.DB  LOW(_strbuf),HIGH(_strbuf)
_prblist_chvalue:
	.DB  0x1,0x0
	.DB  0xB4,0x0
	.DB  0x3,0x0
	.DB  0x2,0x0
	.DB  LOW(_strbuf),HIGH(_strbuf)
_prblist_items:
	.DB  0x1,0x0
	.DB  0xA,0x0
	.DB  0x1E,0x0
	.DB  0xA,0x0
	.DB  LOW(_strbuf),HIGH(_strbuf)
	.DB  0x1,0x0
	.DB  0x82,0x0
	.DB  0x1E,0x0
	.DB  0xA,0x0
	.DB  LOW(_strbuf),HIGH(_strbuf)
	.DB  0x1,0x0
	.DB  0xA,0x0
	.DB  0x28,0x0
	.DB  0xA,0x0
	.DB  LOW(_strbuf),HIGH(_strbuf)
	.DB  0x1,0x0
	.DB  0x82,0x0
	.DB  0x28,0x0
	.DB  0xA,0x0
	.DB  LOW(_strbuf),HIGH(_strbuf)
	.DB  0x1,0x0
	.DB  0xA,0x0
	.DB  0x32,0x0
	.DB  0xA,0x0
	.DB  LOW(_strbuf),HIGH(_strbuf)
	.DB  0x1,0x0
	.DB  0x82,0x0
	.DB  0x32,0x0
	.DB  0xA,0x0
	.DB  LOW(_strbuf),HIGH(_strbuf)
_615:
	.DB  0x1,0x0
_616:
	.DB  0x1,0x0
_0x269:
	.DB  0x1
_tplist_banner:
	.DB  0x5,0x0
	.DB  0x3,0x0
	.DB  0x3,0x0
	.DB  0x8,0x0
	.DB  LOW(_strbuf),HIGH(_strbuf)
_tplist_options:
	.DB  0x1,0x0
	.DB  0xA,0x0
	.DB  0x14,0x0
	.DB  0x8,0x0
	.DB  LOW(_658+0x00),HIGH(_658+0x00)
	.DB  0x1,0x0
	.DB  0x50,0x0
	.DB  0x14,0x0
	.DB  0x8,0x0
	.DB  LOW(_659+0x00),HIGH(_659+0x00)
	.DB  0x1,0x0
	.DB  0xA,0x0
	.DB  0x1E,0x0
	.DB  0x8,0x0
	.DB  LOW(_660+0x00),HIGH(_660+0x00)
	.DB  0x1,0x0
	.DB  0x50,0x0
	.DB  0x1E,0x0
	.DB  0x8,0x0
	.DB  LOW(_661+0x00),HIGH(_661+0x00)
	.DB  0x1,0x0
	.DB  0x96,0x0
	.DB  0x1E,0x0
	.DB  0x8,0x0
	.DB  LOW(_662+0x00),HIGH(_662+0x00)
	.DB  0x1,0x0
	.DB  0xA,0x0
	.DB  0x28,0x0
	.DB  0x8,0x0
	.DB  LOW(_663+0x00),HIGH(_663+0x00)
	.DB  0x1,0x0
	.DB  0x50,0x0
	.DB  0x28,0x0
	.DB  0x8,0x0
	.DB  LOW(_664+0x00),HIGH(_664+0x00)
	.DB  0x1,0x0
	.DB  0x96,0x0
	.DB  0x28,0x0
	.DB  0x8,0x0
	.DB  LOW(_665+0x00),HIGH(_665+0x00)
	.DB  0x1,0x0
	.DB  0xA,0x0
	.DB  0x32,0x0
	.DB  0x8,0x0
	.DB  LOW(_666+0x00),HIGH(_666+0x00)
_667:
	.DB  0x1,0x0
_668:
	.DB  0x1,0x0
_pgprbcfg_banner:
	.DB  0x4,0x0
	.DB  0x3,0x0
	.DB  0x3,0x0
	.DB  0x8,0x0
	.DB  LOW(_strbuf),HIGH(_strbuf)
_snlbl:
	.DB  0x4,0x0
	.DB  0xA,0x0
	.DB  0x11,0x0
	.DB  0x4,0x0
	.DB  LOW(_716+0x00),HIGH(_716+0x00)
_snval:
	.DB  0x1,0x0
	.DB  0x4B,0x0
	.DB  0x16,0x0
	.DB  0xA,0x0
	.DB  LOW(_strbuf),HIGH(_strbuf)
_typelbl:
	.DB  0x4,0x0
	.DB  0xA,0x0
	.DB  0x1F,0x0
	.DB  0x3,0x0
	.DB  LOW(_717+0x00),HIGH(_717+0x00)
_typeval:
	.DB  0x1,0x0
	.DB  0x3B,0x0
	.DB  0x24,0x0
	.DB  0xA,0x0
	.DB  LOW(_strbuf),HIGH(_strbuf)
_paramlbl1:
	.DB  0x4,0x0
	.DB  0x82,0x0
	.DB  0x1F,0x0
	.DB  0x3,0x0
	.DB  LOW(_718+0x00),HIGH(_718+0x00)
_paramval1:
	.DB  0x1,0x0
	.DB  0xA5,0x0
	.DB  0x24,0x0
	.DB  0xA,0x0
	.DB  LOW(_strbuf),HIGH(_strbuf)
_paramlbl2:
	.DB  0x4,0x0
	.DB  0xA,0x0
	.DB  0x2D,0x0
	.DB  0x3,0x0
	.DB  LOW(_719+0x00),HIGH(_719+0x00)
_paramval2:
	.DB  0x1,0x0
	.DB  0x2D,0x0
	.DB  0x32,0x0
	.DB  0xA,0x0
	.DB  LOW(_strbuf),HIGH(_strbuf)
_paramlbl3:
	.DB  0x4,0x0
	.DB  0x82,0x0
	.DB  0x2D,0x0
	.DB  0x3,0x0
	.DB  LOW(_720+0x00),HIGH(_720+0x00)
_paramval3:
	.DB  0x1,0x0
	.DB  0xA5,0x0
	.DB  0x32,0x0
	.DB  0xA,0x0
	.DB  LOW(_strbuf),HIGH(_strbuf)
_boot_banner:
	.DB  0x5,0x0
	.DB  0x3,0x0
	.DB  0x3,0x0
	.DB  0x7,0x0
	.DB  LOW(_736+0x00),HIGH(_736+0x00)
_boot_options:
	.DB  0x5,0x0
	.DB  0xA,0x0
	.DB  0x17,0x0
	.DB  0x7,0x0
	.DB  LOW(_737+0x00),HIGH(_737+0x00)
	.DB  0x5,0x0
	.DB  0x82,0x0
	.DB  0x17,0x0
	.DB  0x7,0x0
	.DB  LOW(_738+0x00),HIGH(_738+0x00)
	.DB  0x5,0x0
	.DB  0xA,0x0
	.DB  0x2D,0x0
	.DB  0x7,0x0
	.DB  LOW(_739+0x00),HIGH(_739+0x00)
	.DB  0x5,0x0
	.DB  0x82,0x0
	.DB  0x2D,0x0
	.DB  0x7,0x0
	.DB  LOW(_740+0x00),HIGH(_740+0x00)
_741:
	.DB  0x1
_742:
	.DB  0x1
_0x2F6:
	.DB  0x0,0x0
	.DB  0x0,0x0
_771:
	.DW  0x00
_datalbl:
	.DB  0x5,0x0
	.DB  0x1E,0x0
	.DB  0xA,0x0
	.DB  0x8,0x0
	.DB  LOW(_strbuf),HIGH(_strbuf)
_databox:
	.DB  0x5,0x0
	.DB  0x1E,0x0
	.DB  0x1E,0x0
	.DB  0x8,0x0
	.DB  LOW(_databuf),HIGH(_databuf)
__fround_GD:
	.DB  0x0,0x0,0x0,0x3F,0xCD,0xCC,0x4C,0x3D
	.DB  0xA,0xD7,0xA3,0x3B,0x6F,0x12,0x3,0x3A
	.DB  0x17,0xB7,0x51,0x38,0xAC,0xC5,0xA7,0x36
	.DB  0xBD,0x37,0x6,0x35
_0:
	.DB  0xD5,0xFD,0xD4,0xDA,0xC6,0xF4,0xB6,0xAF
	.DB  0x2E,0x2E,0x2E,0x0,0xD5,0xFD,0xD4,0xDA
	.DB  0xB8,0xFC,0xD0,0xC2,0xCA,0xFD,0xBE,0xDD
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	.DB  0xE7,0xC5,0xBC,0xC5,0xE4,0xD6,0xC3,0x0

__GLOBAL_INI_TBL:
	.DW  0x0C
	.DW  _3
	.DW  _0*2

	.DW  0x10
	.DW  _4
	.DW  _0*2+0x0C

	.DW  0x02
	.DW  0x06
	.DW  _5*2

	.DW  0x02
	.DW  0x08
	.DW  _6*2

	.DW  0x01
	.DW  _tA_G1
	.DW  _58*2

	.DW  0x01
	.DW  _tB_G1
	.DW  _59*2

	.DW  0x03
	.DW  _head_G8
	.DW  _386*2

	.DW  0x03
	.DW  _tail_G8
	.DW  _387*2

	.DW  0x0A
	.DW  _idle_G8
	.DW  _395*2

	.DW  0x04
	.DW  _reading_G9
	.DW  _412*2

	.DW  0x0F
	.DW  _480
	.DW  _0*2+0xC8

	.DW  0x10
	.DW  _481
	.DW  _0*2+0xD7

	.DW  0x0B
	.DW  _482
	.DW  _0*2+0xE7

	.DW  0x0D
	.DW  _483
	.DW  _0*2+0xF2

	.DW  0x0F
	.DW  _484
	.DW  _0*2+0xFF

	.DW  0x0F
	.DW  _485
	.DW  _0*2+0x10E

	.DW  0x01
	.DW  0x0C
	.DW  _488*2

	.DW  0x01
	.DW  _last_sel_S45
	.DW  _489*2

	.DW  0x0F
	.DW  _508
	.DW  _0*2+0x149

	.DW  0x11
	.DW  _509
	.DW  _0*2+0x158

	.DW  0x11
	.DW  _510
	.DW  _0*2+0x169

	.DW  0x01
	.DW  _curr_sel_S46
	.DW  _511*2

	.DW  0x01
	.DW  _last_sel_S46
	.DW  _512*2

	.DW  0x09
	.DW  _529
	.DW  _0*2+0x17A

	.DW  0x13
	.DW  _574
	.DW  _0*2+0x195

	.DW  0x02
	.DW  _curr_pos_S48
	.DW  _575*2

	.DW  0x02
	.DW  _last_pos_S48
	.DW  _576*2

	.DW  0x02
	.DW  _curr_pos_S49
	.DW  _615*2

	.DW  0x02
	.DW  _last_pos_S49
	.DW  _616*2

	.DW  0x08
	.DW  _658
	.DW  _0*2+0x1C5

	.DW  0x07
	.DW  _659
	.DW  _0*2+0x1CD

	.DW  0x09
	.DW  _660
	.DW  _0*2+0x1D4

	.DW  0x09
	.DW  _661
	.DW  _0*2+0x1DD

	.DW  0x09
	.DW  _662
	.DW  _0*2+0x1E6

	.DW  0x09
	.DW  _663
	.DW  _0*2+0x1EF

	.DW  0x09
	.DW  _664
	.DW  _0*2+0x1F8

	.DW  0x09
	.DW  _665
	.DW  _0*2+0x201

	.DW  0x09
	.DW  _666
	.DW  _0*2+0x20A

	.DW  0x02
	.DW  _curr_sel_S4A
	.DW  _667*2

	.DW  0x02
	.DW  _last_sel_S4A
	.DW  _668*2

	.DW  0x09
	.DW  _716
	.DW  _0*2+0x26B

	.DW  0x07
	.DW  _717
	.DW  _0*2+0x274

	.DW  0x04
	.DW  _718
	.DW  _0*2+0x27B

	.DW  0x04
	.DW  _719
	.DW  _0*2+0x27F

	.DW  0x04
	.DW  _720
	.DW  _0*2+0x283

	.DW  0x0F
	.DW  _736
	.DW  _0*2+0x2DD

	.DW  0x0D
	.DW  _737
	.DW  _0*2+0x2EC

	.DW  0x0D
	.DW  _738
	.DW  _0*2+0x2F9

	.DW  0x0D
	.DW  _739
	.DW  _0*2+0x306

	.DW  0x0D
	.DW  _740
	.DW  _0*2+0x313

	.DW  0x01
	.DW  _curr_sel_S4D
	.DW  _741*2

	.DW  0x01
	.DW  _last_sel_S4D
	.DW  _742*2

	.DW  0x02
	.DW  _curr_window
	.DW  _771*2

	.DW  0
_0x47E:
